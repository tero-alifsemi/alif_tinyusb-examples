&ns {
	status = "okay";
};

&gpio5 {
    status = "okay";
};

// UART2 pins are located to P5 with GPIO5 (P5_2 and P5_3), so we do not want to configure them
// to GPIO mode to avoid conflicts
&pinctrl_gpio5 {
	group0 {
		pinmux = <PIN_P5_0__GPIO>,
			 <PIN_P5_4__GPIO>,
			 <PIN_P5_5__GPIO>,
			 <PIN_P5_6__GPIO>,
			 <PIN_P5_7__GPIO>;
		read-enable = <0x1>;
        driver-state-control = <1>;
	};
};

